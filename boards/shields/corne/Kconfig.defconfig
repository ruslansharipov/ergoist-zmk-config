## boards/shields/corne/Kconfig.defconfig
```kconfig
if SHIELD_CRNX_LEFT

config ZMK_KEYBOARD_NAME
    default "ru_crnx"

config ZMK_SPLIT_ROLE_CENTRAL
    default y

endif

if SHIELD_CRNX_LEFT || SHIELD_CRNX_RIGHT

config ZMK_SPLIT
    default y

endif
```

## boards/shields/corne/Kconfig.shield
```kconfig
config SHIELD_CRNX_LEFT
    def_bool $(shields_list_contains,crnx_left)

config SHIELD_CRNX_RIGHT
    def_bool $(shields_list_contains,crnx_right)
```

## boards/shields/ergoist/Kconfig.defconfig
```kconfig
if SHIELD_ERGOIST_LEFT

config ZMK_KEYBOARD_NAME
    default "Ergoist"

config ZMK_SPLIT_ROLE_CENTRAL
    default y

endif

if SHIELD_ERGOIST_LEFT || SHIELD_ERGOIST_RIGHT

config ZMK_SPLIT
    default y

endif
```

## boards/shields/ergoist/Kconfig.shield
```kconfig
config SHIELD_ERGOIST_LEFT
    def_bool $(shields_list_contains,ergoist_left)

config SHIELD_ERGOIST_RIGHT
    def_bool $(shields_list_contains,ergoist_right)
```
